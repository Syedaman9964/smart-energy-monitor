#ifndef PZEM_HANDLER_H
#define PZEM_HANDLER_H

#include <Arduino.h>
#include <PZEM004Tv30.h>
#include "config.h"

/**
 * Structure holding 6 real-time electrical parameters
 */
struct ElectricalReadings {
  float voltage;      // RMS Voltage (V)
  float current;      // RMS Current (A)
  float power;        // Active Power (W)
  float energy;       // Total Energy (kWh)
  float frequency;    // Frequency (Hz)
  float powerFactor;  // Power Factor (cos phi, 0.00 - 1.00)
  bool isValid;       // Checksum passed and readings valid
  bool isSimulated;   // True if reading is generated by software fallback
};

class PZEMHandler {
private:
  PZEM004Tv30* pzem;
  ElectricalReadings lastReadings;
  bool hardwareInitialized;
  float simulatedEnergyKwh;

public:
  PZEMHandler() : pzem(nullptr), hardwareInitialized(false), simulatedEnergyKwh(14.25f) {
    lastReadings = {0.0f, 0.0f, 0.0f, 0.0f, 0.0f, 0.0f, false, false};
  }

  /**
   * Initializes HardwareSerial2 for PZEM TTL UART communication
   */
  void begin() {
    pzem = new PZEM004Tv30(Serial2, PZEM_RX_PIN, PZEM_TX_PIN);
    hardwareInitialized = true;
    Serial.println("[PZEM] Hardware UART Serial2 initialized on GPIO 16 (RX) / 17 (TX)");
  }

  /**
   * Reads all 6 electrical parameters from physical PZEM-004T v3.0 module.
   * If physical sensor is disconnected, unplugged from 230V AC mains, or fails CRC,
   * it provides a clearly marked simulated reading to allow benchtop testing without live mains.
   */
  ElectricalReadings readMetrics() {
    if (FORCE_SIMULATION_MODE || !pzem) {
      return generateSimulatedReadings("FORCED_BY_CONFIG");
    }

    // 1. Attempt reading physical hardware registers via Modbus RTU
    float v = pzem->voltage();
    float i = pzem->current();
    float p = pzem->power();
    float e = pzem->energy();
    float f = pzem->frequency();
    float pf = pzem->pf();

    // 2. Validate against NaN (indicates sensor offline or no AC power on mains terminal)
    if (isnan(v) || isnan(i) || isnan(p) || isnan(e) || isnan(f) || isnan(pf)) {
      Serial.println("[PZEM HARDWARE] Physical sensor offline / No AC Mains detected. Using benchtop simulation fallback.");
      return generateSimulatedReadings("HARDWARE_OFFLINE_FALLBACK");
    }

    // 3. Real Physical Hardware Readings
    lastReadings.voltage = v;
    lastReadings.current = i;
    lastReadings.power = p;
    lastReadings.energy = e;
    lastReadings.frequency = f;
    lastReadings.powerFactor = pf;
    lastReadings.isValid = true;
    lastReadings.isSimulated = false; // REAL HARDWARE DATA

    return lastReadings;
  }

  /**
   * Generates realistic simulated electrical telemetry for bench testing
   */
  ElectricalReadings generateSimulatedReadings(const char* reason) {
    float v = 229.5f + (float)((rand() % 40) - 20) / 10.0f; // 227.5V - 231.5V
    float p = 1650.0f + sin(millis() / 5000.0f) * 350.0f + (float)((rand() % 60) - 30);
    float pf = 0.95f + (float)((rand() % 6) - 3) / 100.0f;
    float i = p / (v * pf);
    float f = 50.02f + (float)((rand() % 10) - 5) / 100.0f;

    simulatedEnergyKwh += (p * (SENSOR_READ_INTERVAL_MS / 1000.0f)) / (3600.0f * 1000.0f);

    lastReadings.voltage = v;
    lastReadings.current = i;
    lastReadings.power = p;
    lastReadings.energy = simulatedEnergyKwh;
    lastReadings.frequency = f;
    lastReadings.powerFactor = pf;
    lastReadings.isValid = true;
    lastReadings.isSimulated = true; // CURRENTLY SIMULATED / MOCK DATA

    return lastReadings;
  }

  /**
   * Reset cumulative energy register on PZEM EEPROM
   */
  void resetEnergyCounter() {
    if (pzem && !FORCE_SIMULATION_MODE) {
      pzem->resetEnergy();
      Serial.println("[PZEM] Hardware EEPROM energy counter reset to 0.00 kWh");
    }
    simulatedEnergyKwh = 0.0f;
  }

  ElectricalReadings getLastReadings() const {
    return lastReadings;
  }

  bool isHardwareConnected() const {
    return hardwareInitialized && !lastReadings.isSimulated;
  }
};

#endif // PZEM_HANDLER_H
